#include<p18F4550.inc>

loop_cnt1	set 0x00
loop_cnt2	set 0x01
			org 0x00
			goto START
			org 0x08
			retfie
			org 0x18
			retfie

dup_nop	macro kk
		variable i

i = 0
		while i < kk
		nop
i += 1 
		endw
		endm


;move led to left
MoveLEDL 	RRNCF PORTD, F, A
			BSF PORTD, 7, A
			CALL DELAY
			RETURN

;move led to right
MoveLEDR 	RLNCF PORTD, F, A
			BSF PORTD, 0, A
			CALL DELAY
			RETURN

;move led left without SET
MovLEDL 	RRNCF PORTD, F, A
			CALL DELAY
			RETURN

;move led right without SET
MovLEDR 	RLNCF PORTD, F, A
			CALL DELAY
			RETURN

;CLEAR WHILE RUN L
CLEDL		BCF PORTD, 0, A
			RRNCF PORTD, F, A
			CALL DELAY
			RETURN

;CLEAR WHILE RUN R
CLEDR		BCF PORTD, 7, A
			RLNCF PORTD, F, A
			CALL DELAY
			RETURN

LED_ON1	CALL BUZZER1
		CALL MoveLEDL	
		CALL MoveLEDL
		CALL BUZZER1
		CALL MovLEDL
		CALL MovLEDL
		CALL MovLEDL
		CALL MovLEDL
		CALL MovLEDL
		CALL BUZZER1
		CALL CLEDL
		CALL CLEDL
		CALL BUZZER1
		CALL MoveLEDR
		CALL MoveLEDR
		CALL BUZZER1
		CALL MovLEDR
		CALL MovLEDR
		CALL MovLEDR
		CALL MovLEDR
		CALL MovLEDR
		CALL BUZZER1
		CALL CLEDR
		CALL CLEDR
		BTFSC PORTB, 2
		BRA LED_ON1
		RETURN

ONLED	CLRF TRISD,A
		CLRF PORTD,A
		MOVLW 0xFF
		MOVFF WREG, PORTD
		RETURN

OFFLED	CLRF TRISD, A
		CLRF PORTD,A
		RETURN

LED_ON2	CALL BUZZER
		CALL DELAY
		CALL ONLED
		CALL DELAY
		CALL OFFLED
		BTFSC PORTB,2
		BRA LED_ON2
		RETURN

BUZZER 	BSF PORTC,2 ,A
		CALL DELAY
		BCF PORTC,2, A
		CALL DELAY
		RETURN

BUZZER1	BSF PORTC,2 ,A
		CALL DELAY1
		BCF PORTC,2, A
		CALL DELAY1	
		RETURN

START		SETF TRISB, A
			CLRF TRISD, A
			CLRF PORTD, A
			BCF	TRISC,2,A
			BCF	PORTC,2,A
			CALL DELAY

SW1			BTFSS PORTB,0
			CALl  LED_ON1
SW2			BTFSS PORTB,1
			CALL LED_ON2
SW3			BTFSC PORTB,2
			CALL OFFLED
			BRA	SW1
			NOP
			



DELAY	MOVLW D'10'
	MOVWF loop_cnt2, A
AGAIN1	MOVLW D'250'
	MOVWF loop_cnt1, A
AGAIN2	dup_nop D'247'
	DECFSZ loop_cnt1, F, A
	BRA AGAIN2
	DECFSZ loop_cnt2, F, A
	BRA AGAIN1
	NOP
	RETURN

DELAY1	MOVLW D'1'
	MOVWF loop_cnt2, A
AGAIN3	MOVLW D'250'
	MOVWF loop_cnt1, A
AGAIN4	dup_nop D'247'
	DECFSZ loop_cnt1, F, A
	BRA AGAIN4
	DECFSZ loop_cnt2, F, A
	BRA AGAIN3
	NOP
	RETURN
	END


